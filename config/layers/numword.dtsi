numword {
    bindings = <
        &trans        &trans          &trans           &trans           &trans                                                                                                          &trans           &trans           &trans          &trans               &trans
        &trans        &trans          &trans           &trans           &trans        &trans                                                                          &trans            &trans           &trans           &trans          &trans               &trans
        &trans        &kp N7          &kp N7           &kp N8           &kp N9        &kp STAR                                                                        &kp BSLH          &kp HASH         &kp AMPS         &kp PIPE        &kp TILDE            &trans
        &trans        &hml LSFT N7    &hml LCTL N5     &hml LALT N3     &hml LGUI N1  &hml HYPER N5                                                                   &hmr HYPER N6     &hmr RSHFT N0    &hmr RCTRL N2    &hmr RALT N4    &hmr RGUI N6         &trans
        &trans        &kp LT          &kp N1           &kp N2           &hmr MEH N9   &kp AT   &kp LCTRL   &kp LALT    &kp LGUI  &kp LGUI  &kp RALT  &kp RCTRL        &trans            &hmr MEH N8      &kp DOT      &trans          &kp GT               &trans
        &trans        &trans          &trans           &trans           &trans                 &kp SPACE   NAV_L       &kp LGUI   &kp RGUI SYM_L     &skq LSFT                          &trans           &trans           &trans          &trans               &trans
    >;
};
