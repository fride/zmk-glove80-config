 hands_down_v_alt {            
    bindings = <
    &to 0          &kp F2          &kp F3      &kp F4      &kp F5                                                                                                  &kp F6       &kp F7      &kp F8              &kp F9         &kp F10
    &kp EQUAL      &kp N1          &kp N2      &kp LEFT    &kp RIGHT      &kp N5                                                                         &kp HOME  &kp UP       &kp DOWN    &kp END             &kp N0         &kp MINUS
    &kp TAB        &kp V           &kp W       &kp M       &kp G          &kp J                                                                          &kp HASH  &kp RA(A)    &kp RA(U)   &PuqDqt ALPHA2 0    &kp RA(O)          &kp BSLH
    &kp ESC        &hml LCTL S     &hml LALT C &hml LGUI N &hml LSFT T    &kp K                                                                          &kp COMMA &kp A        &kp E       &kp I               &kp H          &kp SQT
    &kp GRAVE      &kp X           &kp P       &kp L       &kp D          &kp B       &kp LCTRL   &kp LALT    &kp LGUI  &kp LGUI  &kp RALT  &kp RCTRL    &kp MINUS &kp U        &kp O       &kp Y               &kp F          &kp PG_UP
    &mo MAGIC      &kp HOME        &kp END     &kp LEFT    &kp RIGHT                  NAV_R       &magic      &kp LGUI   &kp RGUI &magic    NUM_SPC                &kp UP       &kp DOWN    &kp LBKT            &kp RBKT       &mo MAGIC
    >;
};
