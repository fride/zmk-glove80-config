 hands_down_vv {            
    bindings = <
    &to 0          &kp F2          &kp F3      &kp F4      &kp F5                                                                                                  &kp F6       &kp F7      &kp F8      &kp F9         &kp F10
    &kp EQUAL      &kp N1          &kp N2      &kp LEFT    &kp RIGHT      &kp N5                                                                         &kp HOME  &kp UP       &kp DOWN    &kp END     &kp N0         &kp MINUS
    &kp TAB        &kp X           &kp W       &kp M       &kp G          &kp DQT                                                                        &kp HASH  &kp DOT      &kp SQT     &kp J       &kp B          &kp BSLH
    &kp ESC        &kp S           &kp C       &kp N       &kp T          &kp K                                                                          &kp COMMA &kp A        &kp E       &kp I       &kp H          &kp SQT
    &kp GRAVE      &kp V           &kp P       &kp L       &kp D          &kp SLASH   &kp LCTRL   &kp LALT    &kp LGUI  &kp LGUI  &kp RALT  &kp RCTRL    &kp MINUS &kp U        &kp O       &kp Y       &kp F          &kp PG_UP
    &mo MAGIC      &kp HOME        &kp END     &kp LEFT    &kp RIGHT                  NAV_R       &magic      &kp LGUI   &kp RGUI &magic    NUM_SPC                &kp UP       &kp DOWN    &kp LBKT    &kp RBKT       &mo MAGIC
    >;
};
