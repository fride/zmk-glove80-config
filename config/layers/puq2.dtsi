puq_alt {            
    bindings = <
    &trans         &rtans          &trans      &trans      &trans                                                                                              &trans         &rtans          &trans      &trans         &trans
    &kp EQUAL      &kp N1          &kp N2      &kp LEFT    &kp RIGHT      &kp N5                                                                     &kp HOME  &kp UP         &kp DOWN        &kp END     &kp N0         &kp MINUS
    &kp TAB        &kp Z           &kp M       &kp L       &ch            &kp G                                                                      &kp Q     &Arrow         &FatArrow       &kp RA(U)   &kp P          &kp BSLH
    &kp ESC        &kp RA(S)       &kp N       &kp R       &th            &kp D                                                                      &kp RA(O) &kp RA(A)      &kp E           &kp I       &kp H          &kp SQT
    &kp GRAVE      &kp F           &kp B       &kp W       &kp V          &kp J   &skq LSFT   &kp LALT    &kp LGUI  &kp LGUI  &kp RALT  &skq LSFT    &kp X     &kp SQT        &kp SQT         &kp DOT     &kp K          &kp PG_UP
    &trans         &rtans          &trans      &trans      &trans                 NAV_SPACE   &kp LALT    &kp LGUI   &kp RGUI &kp RALT  &skq LSFT              &trans         &trans          &trans      &trans         &tran
    >;
};