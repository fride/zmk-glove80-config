 puq {            
    bindings = <
    &app_swap      &kp F2          &kp F3         &kp F4          &kp F5                                                                                                  &kp F6            &kp F7                &kp F8       &kp F9         &kp F10
    &kp EQUAL      &win_swap       &app_swap      &kp DOWN        &kp UP         &kp N5                                                                     &kp HOME      &kp LEFT          &kp RIGHT             &kp END      &kp DEL        &kp DEL
    &kp TAB        &kp Z           &kp M          &kp L           &hml MEH C     &kp G                                                                      &kp Q         CommQues          &sl ALPHA2            &kp U        &kp P          &kp BSLH
    &kp BSPC       &kp S           &lt NUMBERS N  &lt SYMBOLS R   &lt NAVI T     &hml HYPER D                                                               &hmr HYPER O  &lt NAVI A        &lt SYMBOLS E         &kp I        &kp H          &kp MINUS
    &kp GRAVE      &kp F           &hml LCTL B    &hml LALT W     &hml LGUI V    &kp J   &skq LSFT   &kp LALT    &kp LGUI  &kp LGUI  &kp RALT  &skq LSFT    &kp X         &hmr RGUI SQT     &hmr_dotExcl LALT 0   &hmr RCTL Y  &kp K          &kp PG_UP
    &mo MAGIC      &kp HOME        &kp LBRC       &kp RBKT        &kp RPAR              NAV_SPACE    &skq LGUI   &kp LGUI   &kp RGUI &skq LCTL &skq LSFT                  &kp RPAR          &kp RBKT              &kp RBRC     &kp RBKT       &mo MAGIC
    >;
};