numbers {
    bindings = <
        &trans        &trans          &trans           &trans           &trans                                                                                                          &trans           &trans           &trans          &trans               &trans
        &trans        &trans          &trans           &trans           &trans        &trans                                                                          &trans            &trans           &trans           &trans          &trans               &trans
        &trans        &trans          &trans           &trans           &trans        &trans                                                                          &kp TAB           &kp N7           &kp N8           &kp N9          &kp PLUS             &kp SLASH
        &trans        &hml LSFT N1    &kp LCTRL        &kp LALT         &kp LGUI  &hml HYPER N5                                                                       &kp COLON         &kp N4           &kp N5           &kp N6          &kp MINUS            &kp STAR
        &trans        &trans          &kp HYPER        &kp LGUI         &trans        &trans   &kp LCTRL   &kp LALT    &kp LGUI  &kp LGUI  &kp RALT  &kp RCTRL        &kp COMMA         &kp N1           &kp N2           &kp N3          &kp DOT              &trans
        &trans        &trans          &trans           &trans           &trans                 &kp SPACE   &kp HYPER   &kp LGUI  &kp LT    &kp GT    &kp N0                             &trans           &trans           &trans          &trans               &trans
    >;
};
