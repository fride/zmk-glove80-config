 
 /*
      ╭─────────────────────╮ ╭──────────────────────╮
ESC  │  X   W   M   G   J  │ │  #$  .:  / *  "[  ']  │ BSP
TAB  │  S   C   N   T   K  | |  ,;   A   E    I   H  │ Tg(Num)
LSFT │  B   F   L   D   V  │ │  -+   U   O    Y   F  │ RSFT
     ╰──────╮  App BSP  R  │ │  SPC RET TAB  ╭──-────╯
            ╰──────────────╯ ╰───────────────╯
*/
 hands_down_vv {            
    bindings = <
    &to 0          &kp F2          &kp F3      &kp F4      &kp F5                                                                                                  &kp F6       &kp F7      &kp F8      &kp F9         &kp F10
    &kp EQUAL      &kp N1          &kp N2      &kp LEFT    &kp RIGHT      &kp N5                                                                         &kp HOME  &kp UP       &kp DOWN    &kp END     &kp N0         &kp MINUS
    &kp TAB        &kp X           &kp W       &kp M       &kp G          &kp J                                                                          &kp HASH  &kp DOT      &ad_slash   &kp DQT     &kp SQT        &kp BSLH
    &kp ESC        &hml LCTL S     &hml LALT C &hml LGUI N &hml LSFT T    &kp K                                                                          &kp COMMA &hmr RSFT A  &hmr RGUI E &hmr LALT I &hmr RCTL H    &kp Z
    &kp GRAVE      &kp B           &kp P       &kp L       &kp D          &kp V       &kp LCTRL   &kp LALT    &kp LGUI  &kp LGUI  &kp RALT  &kp RCTRL    &kp MINUS &kp U        &kp O       &kp Y       &kp F          &kp PG_UP
    &mo MAGIC      &kp HOME        &kp END     &kp LEFT    &kp RIGHT                  NAV_R       &magic      &kp LGUI   &kp RGUI &magic    NUM_SPC                &kp UP       &kp DOWN    &kp LBKT    &kp RBKT       &mo MAGIC
    >;
};
