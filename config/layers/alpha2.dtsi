 alpha2 {            
    bindings = <
    &to 0             &kp F2          &kp F3      &kp F4        &kp F5                                                                                                    &kp F6            &kp F7            &kp F8            &kp F9           &kp F10
    &kp EQUAL         &kp N1          &kp N2      &kp LEFT      &kp RIGHT      &kp N5                                                                     &kp LA(LS(N2))  &kp UP            &kp DOWN          &kp END           &kp N0           &kp MINUS
    &kp TAB           &kp Z           &kp Q       &kp YEN       &kp EURO       &kp J                                                                      &kp HASH        &kp RA(U)         &kp RA(O)         &SqtLbkt          &kp RA(S)        &kp BSLH
    &kp BSPC          &kp RA(S)       &kp LBKT    &kp LPAR      &kp LBRC       &kp K                                                                      &kp COMMA       &kp RA(A)         &kp E             &kp RA(A)         &kp H            &kp Z
    &kp GRAVE         &kp X           &kp RBKT    &kp RPAR      &kp RBRC       &kp B   &kp LCTRL   &kp LALT    &kp LGUI  &kp LGUI  &kp RALT  &kp RCTRL    &kp MINUS       &kp Y             &kp SLASH         &kp DOT           &kp F            &kp PG_UP
    &trans            &trans          &trans      &trans        &trans                 &trans      &trans      &trans    &trans    &trans    &trans                       &trans            &trans            &trans            &trans           &trans 
    >;
};