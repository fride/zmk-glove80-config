 alpha1 {            
    bindings = <
    &to 0          &kp F2          &kp F3      &kp F4      &kp F5                                                                                                &kp F6       &kp F7       &kp F8      &kp F9         &kp F10
    &kp EQUAL      &kp N1          &kp N2      &kp LEFT    &kp RIGHT      &kp N5                                                                     &kp HOME    &kp UP       &kp DOWN     &kp END     &kp N0         &kp MINUS
    &kp TAB        &kp V           &kp W       &kp M       &kp G          &kp J                                                                      &kp HASH    &kp U        &kp O        &sl ALPHA2  &DqtRbkt       &kp BSLH
    &kp BSPC       &hml LGUI S     &hml LALT C &hml LCTL N &hml LSFT T    &kp K                                                                      &kp COMMA   &hmr RSFT I  &hmr RCTL E  &hmr LALT A &hmr RGUI H    &kp Z
    &kp GRAVE      &kp X           &kp P       &kp L       &kp D          &kp B   &kp LCTRL   &kp LALT    &kp LGUI  &kp LGUI  &kp RALT  &kp RCTRL    &kp MINUS   &kp Y        &kp SLASH    &kp DOT     &kp F          &kp PG_UP
    &mo MAGIC      &kp HOME        &kp END     &kp LEFT    &kp RIGHT              NAV_R       &magic    &kp LGUI   &kp RGUI   &magic    NUM_SPC                  &kp UP       &kp DOWN     &kp LBKT    &kp RBKT       &mo MAGIC
    >;
};