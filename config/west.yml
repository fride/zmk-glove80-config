## config/west.yml
```yaml
manifest:
  remotes:
    - name: zmkfirmware
      url-base: https://github.com/zmkfirmware
    - name: klausweiss
      url-base: https://github.com/klausweiss
    - name: dhruvinsh
      url-base: https://github.com/dhruvinsh
    # Additional modules containing boards/shields/custom code can be listed here as well
    # See https://docs.zephyrproject.org/3.2.0/develop/west/manifest.html#projects
  projects:
    - name: zmk
      remote: klausweiss
      revision: fix/adaptive-keys
      import: app/west.yml
    - name: zmk-num-word
      remote: dhruvinsh
      revision: main
  self:
    path: config
```
